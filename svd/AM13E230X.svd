# AM13E23019 register map
Vendor: Texas Instruments; File version: 1.0
AM13E23019, generated from the CCS targetdb by targetdb2svd.py
CPU: CM33 r0p1, little endian, MPU, FPU, VTOR, 4 interrupt priority bits
Registers are 32-bit, read-write, reset 0x0 unless marked. A register's access mark holds for its fields unless they carry their own. Offsets are from the block's base; lines under a group give offsets from that group; [hi:lo] are bit positions; {n}, {i} and the like mark numbered series; 'fields as' and 'values as' point back to an identical list; <NAME> marks a mode.

## Memory map
0x40000000 ADC0 size 0x1334 — ADC module
0x40002000 ADC1 size 0x1334
0x40004000 ADC2 size 0x1334
0x4000A000 ADC0RESULT size 0xE0 — ADC_RESULT module
0x4000B000 ADC1RESULT size 0xE0
0x4000C000 ADC2RESULT size 0xE0
0x40010000 MCPWM0 size 0x538 — MCPWM module
0x40011000 MCPWM1 size 0x538
0x40012000 MCPWM2 size 0x538
0x40013000 MCPWM3 size 0x538
0x40014000 MCPWM4 size 0x538
0x40020000 DMA0 size 0x12C0 — DMA module
0x40028000 FRI size 0x1108 — FRI module
0x4002A000 MEMCFG size 0x1018 — MEMCFG module
0x4002C000 EAM size 0x1100 — EAM module
0x40042000 NVMNW size 0x1500 — NVMNW module
0x40046000 GSC size 0x2000 — GSC module
0x400AF000 SYSCTL size 0x14B0 — SYSCTL module
0x400C7000 DEBUGSS size 0x1214 — DEBUGSS module
0x400CC000 IOMUX size 0x1B0 — IOMUX module
0x400D0000 WWDT size 0x1110 — WWDT module
0x400F0000 GPIO0 size 0x1524 — GPIO module
0x400F2000 GPIO1 size 0x1524
0x400F4000 GPIO2 size 0x1524
0x400F6000 GPIO3 size 0x1524
0x400FC000 PGA0 size 0x16 — PGA module
0x400FD000 PGA1 size 0x16
0x400FE000 PGA2 size 0x16
0x40110000 MCAN0 size 0x7910 — MCAN module
0x40180000 TIMG4 size 0x18D8 — GPTIMER module
0x40188000 TIMG12 size 0x18D8
0x401B0000 AES size 0x11F8 — AES module
0x401B2000 CRC size 0x2000 — CRCP module
0x401B6000 KEYSTORE size 0x1118 — KEYSTORECTL module
0x40440000 ECAP0 size 0x40 — ECAP module
0x40441000 ECAP1 size 0x40
0x40448000 EQEP0 size 0x70 — EQEP module
0x40449000 EQEP1 size 0x70
0x4044A000 EQEP2 size 0x70
0x40460000 CMPSS0 size 0x74 — CMPSS_LITE module
0x40461000 CMPSS1 size 0x74
0x40462000 CMPSS2 size 0x74
0x40463000 CMPSS3 size 0x74
0x40468000 INPUTXBAR size 0x420 — INPUT_XBAR module
0x40469000 PWMXBAR size 0x2C8 — EPWM_XBAR module
0x4046A000 OUTPUTXBAR size 0x3C8 — OUTPUTXBAR module
0x4046B000 SYNC size 0xC — SYNC_SOC module
0x40470000 OUTPUTXBAR0_FLAGS size 0x24 — OUTPUTXBAR_FLAG module
0x40471000 OUTPUTXBAR1_FLAGS size 0x24
0x40472000 OUTPUTXBAR2_FLAGS size 0x24
0x40473000 OUTPUTXBAR3_FLAGS size 0x24
0x40474000 OUTPUTXBAR4_FLAGS size 0x24
0x40475000 OUTPUTXBAR5_FLAGS size 0x24
0x40476000 OUTPUTXBAR6_FLAGS size 0x24
0x40477000 OUTPUTXBAR7_FLAGS size 0x24
0x40490000 INPUTXBAR_FLAGS size 0x18 — INPUT_FLAG_XBAR module
0x40600000 UC0_UART size 0x150 — UNICOMMUART module
0x40601000 UC1_UART size 0x150
0x40602000 UC2_UART size 0x150
0x40608000 UC0_I2CC size 0x15C — UNICOMMI2CC module
0x40609000 UC1_I2CC size 0x15C
0x4060A000 UC2_I2CC size 0x15C
0x40610000 UC0_I2CT size 0x15C — UNICOMMI2CT module
0x40611000 UC1_I2CT size 0x15C
0x40612000 UC2_I2CT size 0x15C
0x40618000 UC0_SPI size 0x150 — UNICOMMSPI module
0x40619000 UC1_SPI size 0x150
0x40630000 UNICOMM0 size 0x1104 — UNICOMM module
0x40632000 UNICOMM1 size 0x1104
0x40634000 UNICOMM2 size 0x1104
0x4063F000 SPG0 size 0xC04 — SPGSS module
0x40640000 UC3_UART size 0x150
0x40641000 UC4_UART size 0x150
0x40642000 UC5_UART size 0x150
0x40648000 UC3_I2CC size 0x15C
0x40649000 UC4_I2CC size 0x15C
0x4064A000 UC5_I2CC size 0x15C
0x40650000 UC3_I2CT size 0x15C
0x40651000 UC4_I2CT size 0x15C
0x40652000 UC5_I2CT size 0x15C
0x40658000 UC3_SPI size 0x150
0x40659000 UC4_SPI size 0x150
0x40670000 UNICOMM3 size 0x1104
0x40672000 UNICOMM4 size 0x1104
0x40674000 UNICOMM5 size 0x1104
0x4067F000 SPG1 size 0xC04
0x408FF000 TINIE size 0x3000 — TINIELITE module

## Interrupts
4 GPIO0
5 GPIO1
6 GPIO2
7 GPIO3
8 ADC0_INT1 (ADC0)
9 ADC0_INT2 (ADC0)
10 ADC0_INT3 (ADC0)
11 ADC0_INT4 (ADC0)
12 ADC0_EVT (ADC0)
13 ADC1_INT1 (ADC1)
14 ADC1_INT2 (ADC1)
15 ADC1_INT3 (ADC1)
16 ADC1_INT4 (ADC1)
17 ADC1_EVT (ADC1)
18 ADC2_INT1 (ADC2)
19 ADC2_INT2 (ADC2)
20 ADC2_INT3 (ADC2)
21 ADC2_INT4 (ADC2)
22 ADC2_EVT (ADC2)
23 MCAN0
24 MCPWM0
25 MCPWM1
26 MCPWM2
27 MCPWM3
28 MCPWM4
29 ECAP0
30 ECAP1
31 EQEP0
32 EQEP1
33 EQEP2
40 DMA0
41 TINIE_LITE (TINIE)
43 AES
44 TIMG4_0 (TIMG4)
45 TIMG12_0 (TIMG12)
